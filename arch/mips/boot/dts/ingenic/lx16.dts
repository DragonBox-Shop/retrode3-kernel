/dts-v1/;

#ifndef LX16_REV
#define LX16_REV 	2	// default main board revision for Retrode3
#endif
#ifndef LX16_W
#define LX16_W		2	// 0 = none; WLAN and Bluetooth: 1 = QCom, 2 = ESP32
#endif
#define PWM_LED		0	// 1 = use PWM on led0 and led1
#define SPI_BITBANG	0	// 1 = debug using bitbang gpio
#ifndef APPLICATION
#define APPLICATION	295	// default Retrode hardware version (290, 291, 292, 293, ...)
#endif

#if APPLICATION <= 293
#undef SPI_BITBANG
#define SPI_BITBANG	1	// default to bitbang SPI
#endif

/* choose one board revision */
#if LX16_REV == 1
#error LX16_REV == 1 not available for Retrode3
#elif LX16_REV == 2
#include "lx16-v0.2.dtsi"
#elif LX16_REV >= 3
#error LX16_REV >= 3 not available for Retrode3
#endif

/* choose none or one of the wireless options */
#if LX16_W == 1
#error LX16_W == 1 not available for Retrode3
#elif LX16_W == 2
#include "lx16-wireless-esp32.dtsi"
#endif

#include "lx16+retrode3.dtsi"
